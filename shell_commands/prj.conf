## CMakeLists.txt
```
# SPDX-License-Identifier: Apache-2.0

cmake_minimum_required(VERSION 3.20.0)
find_package(Zephyr REQUIRED HINTS $ENV{ZEPHYR_BASE})
project(shell_commands)

target_sources(app PRIVATE src/main.c)
```

## prj.conf
```kconfig
CONFIG_GPIO=y
CONFIG_SHELL=y
CONFIG_SHELL_CMD_BUFF_SIZE=128
CONFIG_LOG=y
```

## boards/cc1352p1_launchxl.overlay
```dts
/{
	custom_gpios {
 
	   compatible = "gpio-keys";
 
	   cusgpio0: cusgpio_0 {
 
		  gpios = <&gpio0 6 GPIO_ACTIVE_HIGH>;
 
		  label = "My custom GPIO";
 
	   };
 
	};
 
	aliases {
 
	mycusgpio = &cusgpio0;
	};
 
 };
```

## boards/cc26x2r1_launchxl.overlay
```dts
/{
	custom_gpios {
 
	   compatible = "gpio-keys";
 
	   cusgpio0: cusgpio_0 {
 
		  gpios = <&gpio0 25 GPIO_ACTIVE_HIGH>;
 
		  label = "My custom GPIO";
 
	   };
 
	};
 
	aliases {
 
	mycusgpio = &cusgpio0;
	};
 
 };
```

## src/main.c
```c
#include <zephyr/zephyr.h>
#include <zephyr/shell/shell.h>
#include <stdlib.h>
#include <zephyr/logging/log.h>

LOG_MODULE_REGISTER(shell_example, LOG_LEVEL_INF);

static int cmd_my_command(const struct shell *shell, size_t argc, char **argv)
{
    // Example command implementation
    shell_print(shell, "My command was executed with %d arguments", argc - 1);
    // for (int i = 1; i < argc; i++) {
    //     shell_print(shell, "arg[%d]: %s", i, argv[i]);
    // }
    return 0;
}

SHELL_CMD_REGISTER(my_command, NULL, "Description of my command", cmd_my_command);

void main(void)
{
    // Application main function
    LOG_INF("Shell example started");
}
```
