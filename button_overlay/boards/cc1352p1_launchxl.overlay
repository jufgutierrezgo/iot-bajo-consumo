/{
	custom_gpios {
 
	   compatible = "gpio-keys";
 
	   buttoncus: buttoncus {
 
		  gpios = <&gpio0 15 (GPIO_ACTIVE_LOW | GPIO_PULL_UP)>;
 
		  label = "My custom button";
 
	   };
 
	};
 
	aliases {
 
	mycusbutton = &buttoncus;
	};
 
 };