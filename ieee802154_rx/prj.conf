## CMakeLists.txt
```
# SPDX-License-Identifier: Apache-2.0

cmake_minimum_required(VERSION 3.20.0)
find_package(Zephyr REQUIRED HINTS $ENV{ZEPHYR_BASE})


project(project3wireless)

# Link OpenThread libraries
# target_link_libraries(app PUBLIC openthread)


target_include_directories(
  app
  PRIVATE
  ${ZEPHYR_BASE}/subsys/net/ip
  ${ZEPHYR_BASE}/subsys/net/l2/ieee802154
  )

target_sources(app PRIVATE src/main.c)
```

## prj.conf
```kconfig
# Enable networking support
CONFIG_NETWORKING=y

# Enable the IEEE 802.15.4 stack
CONFIG_NET_L2_IEEE802154=y
# CONFIG_NET_L2_IEEE802154_MGMT=y
# CONFIG_NET_L2_IEEE802154_SECURITY=y  # If you're using security

# Enable raw socket support (for sending/receiving raw IEEE 802.15.4 frames)
CONFIG_NET_SOCKETS=y
CONFIG_NET_SOCKETS_PACKET=y

# Enable support for 802.15.4
CONFIG_IEEE802154=y

# Enable the radio driver for your specific platform (nRF52840 in this case)
CONFIG_IEEE802154_CC13XX_CC26XX=y


# The TX power to use by default in the sample application.
# CONFIG_NET_CONFIG_IEEE802154_TX_POWER=10

# Enable network management support
# CONFIG_NET_MGMT=y
# CONFIG_NET_MGMT_EVENT=y
# CONFIG_NET_MGMT_EVENT_INFO=y
# CONFIG_NET_MGMT_EVENT_STACK_SIZE=512

# Enable default network interface if necessary
# CONFIG_NET_DEFAULT_IF_ETHERNET=n
# CONFIG_NET_DEFAULT_IF_WIFI=n
# CONFIG_NET_DEFAULT_IF_BLUETOOTH=n
CONFIG_NET_DEFAULT_IF_IEEE802154=y

# Enable logging to help with debugging

# Enable logging
CONFIG_LOG=y
# Enable logging in the system initialization code
# CONFIG_LOG_DEFAULT_LEVEL=4  # 0=none, 1=error, 2=warning, 3=info, 4=debug
# Enable logging for the IEEE 802.15.4 subsystem
# CONFIG_IEEE802154_LOG_LEVEL_DBG=y
# Enable logging for network interfaces
# CONFIG_NET_IF_LOG_LEVEL_DBG=y


# Network interface settings
# CONFIG_NET_IF_UNICAST_IPV6_ADDR_COUNT=3
# CONFIG_NET_L2_IEEE802154_RADIO_CSMA_CA=y`
# CONFIG_NET_L2_IEEE802154_LOG_LEVEL_DBG=y

# Enable packet buffering if necessary
CONFIG_NET_PKT_RX_COUNT=10
CONFIG_NET_PKT_TX_COUNT=10
CONFIG_NET_BUF_RX_COUNT=10
CONFIG_NET_BUF_TX_COUNT=10

# Disable IP (if not using IP over IEEE 802.15.4)
CONFIG_NET_IPV6=y
CONFIG_NET_IPV4=n

# Enable shell for debugging
CONFIG_SHELL=y
# CONFIG_SHELL_LOG_LEVEL=3

CONFIG_NET_PROMISCUOUS_MODE=y
# CONFIG_MAIN_STACK_SIZE=4096
# CONFIG_NET_RX_STACK_SIZE=4096

CONFIG_NET_L2_IEEE802154_LOG_LEVEL_DBG=n
# CONFIG_NET_L2_IEEE802154_LOG_LEVEL=4
# CONFIG_IEEE802154_DRIVER_LOG_LEVEL=4

# Activate DEBUGGING for IEEE802154 driver
CONFIG_IEEE802154_DRIVER_LOG_LEVEL_DBG=n
# CONFIG_IEEE802154_DRIVER_LOG_LEVEL_WRN=y


# CONFIG_NET_PKT_RX_COUNT=10
# CONFIG_NET_BUF_DATA_SIZE=1280

# CONFIG_NET_BUF=y
# CONFIG_NET_PKT_LOG_LEVEL_DBG=y
```

## boards/cc26x2r1_launchxl.overlay
```dts
/ {
	chosen {
		zephyr,ieee802154 = &ieee802154;		
	};
};

&ieee802154 {
	status = "okay";
};
```

## src/main.c
```c
#include <zephyr/kernel.h>
#include <zephyr/device.h>
#include <zephyr/net/ieee802154.h>
#include <zephyr/net/ieee802154_mgmt.h>
#include <zephyr/net/ieee802154_radio.h>
#include <zephyr/net/net_core.h>
#include <zephyr/net/net_ip.h>
#include <zephyr/net/net_if.h>
#include <zephyr/net/net_pkt.h>
#include <zephyr/sys/printk.h>

#define IEEE802154_CHANNEL 11  // Set the channel to your network's channel
#define IEEE802154_PAN_ID 0xABCD // Example PAN ID
#define IEEE802154_SHORT_ADDR 0x7777 // Example short address

// LOG_MODULE_REGISTER(ieee802154, LOG_LEVEL_DBG);
// LOG_MODULE_REGISTER(ieee802154_cc13xx_cc26xx, LOG_LEVEL_DBG);
LOG_MODULE_REGISTER(main, LOG_LEVEL_INF);

// Function to process a received packet
void process_packet(struct net_pkt *pkt)
{
    struct net_buf *frag;
    size_t total_len = 0;

    for (frag = pkt->frags; frag; frag = frag->frags) {
        total_len += frag->len;
        printk("Frag. Length: %d\n", frag->len);
        printk("Frag Data: ");
        for (size_t i = 0; i < frag->len; i++) {
            printk("%02x ", frag->data[i]);
        }
        printk("\n");
    }
    printk("Total pkt length: %zu bytes\n", total_len);

    net_pkt_unref(pkt);
}

// Configure IEEE 802.15.4 settings
void configure_ieee802154(struct net_if *iface)
{
    struct ieee802154_req_params params = {0};

    // Set the channel
    params.channel = IEEE802154_CHANNEL;
    if (net_mgmt(NET_REQUEST_IEEE802154_SET_CHANNEL, iface, &params.channel, sizeof(params.channel)) < 0) {
        printk("Failed to set channel\n");
        return;
    }

    // Set PAN ID
    params.pan_id = IEEE802154_PAN_ID;
    if (net_mgmt(NET_REQUEST_IEEE802154_SET_PAN_ID, iface, &params.pan_id, sizeof(params.pan_id)) < 0) {
        printk("Failed to set PAN ID\n");
        return;
    }

    // Set short address
    params.short_addr = IEEE802154_SHORT_ADDR;
    if (net_mgmt(NET_REQUEST_IEEE802154_SET_SHORT_ADDR, iface, &params.short_addr, sizeof(params.short_addr)) < 0) {
        printk("Failed to set short address\n");
        return;
    }

    printk("IEEE 802.15.4 PAN ID, short address, and channel configured.\n");

    int ret = net_promisc_mode_on(iface);
	if (ret < 0) {
		LOG_INF("Cannot set promiscuous mode for interface %p (%d)",
			iface, ret);
		return;
	}

	LOG_INF("Promiscuous mode enabled for interface %p", iface);
}

void print_iface_info(struct net_if *iface) {
    if (!iface) {
        printk("Network interface not available\n");
        return;
    }

    // Print the interface index (unique identifier for the interface)
    printk("Interface index: %d\n", net_if_get_by_iface(iface));

    // Print the link address (MAC address or equivalent)
    struct net_linkaddr *link_addr = net_if_get_link_addr(iface);
    printk("Link address: ");
    for (int i = 0; i < link_addr->len; i++) {
        printk("%02x", link_addr->addr[i]);
        if (i < link_addr->len - 1) {
            printk(":");
        }
    }
    printk("\n");

    // Print if the interface is up or down
    if (net_if_is_up(iface)) {
        printk("Interface is up\n");
    } else {
        printk("Interface is down\n");
    }
}

void main(void)
{
    struct net_if *iface;
    struct net_pkt *pkt;

    // Get the default network interface
    iface = net_if_get_default();
    if (!iface) {
        printk("No network interface found\n");
        return;
    }
    
    // Configure PAN ID and short address
    configure_ieee802154(iface);
    net_if_up(iface);

    print_iface_info(iface);    

    printk("Waiting for packets.\n");

    // Keep running to receive packets
    while (1) {
        pkt = net_promisc_mode_wait_data(K_FOREVER);
		if (pkt) {
			process_packet(pkt);
		}

		net_pkt_unref(pkt);
    }
}
```
