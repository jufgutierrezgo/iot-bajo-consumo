## sample.yaml
```
sample:
  name: SHTC3 Humidity Sensor Sample
tests:
  sample.sensor.shtc3:
    tags:
      - sensor
      - i2c
      - humidity
    filter: dt_compat_enabled("sensirion,shtc3")
    depends_on: i2c
    harness: console
    integration_platforms:
      - cc1352p1_launchxl
```

## prj.conf
```kconfig
# Generic networking options
CONFIG_NETWORKING=y
CONFIG_NET_UDP=y
CONFIG_NET_TCP=n
CONFIG_NET_IPV6=y
CONFIG_NET_IPV4=y
CONFIG_NET_SOCKETS=y
CONFIG_NET_SOCKETS_PACKET=y
CONFIG_POSIX_API=y

CONFIG_REQUIRES_FULL_LIBC=y
CONFIG_NET_SOCKETS_POLL_MAX=4

# Network application options and configuration
CONFIG_NET_CONFIG_SETTINGS=y
CONFIG_NET_CONNECTION_MANAGER=y
# Network application options and configuration
CONFIG_NET_CONFIG_SETTINGS=y
CONFIG_NET_CONFIG_NEED_IPV6=y
CONFIG_NET_CONFIG_MY_IPV6_ADDR="2001:db8::1"
CONFIG_NET_CONFIG_PEER_IPV6_ADDR="2001:db8::2"
CONFIG_NET_IF_MCAST_IPV6_ADDR_COUNT=5
CONFIG_NET_CONFIG_NEED_IPV4=y
CONFIG_NET_CONFIG_MY_IPV4_ADDR="192.0.2.1"
CONFIG_NET_CONFIG_PEER_IPV4_ADDR="192.0.2.2"

# Enable the IEEE 802.15.4 stack
CONFIG_NET_L2_IEEE802154=y
# CONFIG_NET_L2_IEEE802154_MGMT=y
# CONFIG_NET_L2_IEEE802154_SECURITY=y  # If you're using security

# Enable support for 802.15.4
CONFIG_IEEE802154=y
# Enable the radio driver for your specific platform (nRF52840 in this case)
CONFIG_IEEE802154_CC13XX_CC26XX=y

CONFIG_NET_CONFIG_IEEE802154_CHANNEL=11
CONFIG_NET_CONFIG_IEEE802154_PAN_ID=0xABCD

# The TX power to use by default in the sample application.
# CONFIG_NET_CONFIG_IEEE802154_TX_POWER=10

# Enable network management support
# Events
CONFIG_NET_MGMT=y
CONFIG_NET_MGMT_EVENT=y
CONFIG_NET_MGMT_EVENT_INFO=y

# Enable default network interface if necessary
CONFIG_NET_DEFAULT_IF_ETHERNET=n
CONFIG_NET_DEFAULT_IF_WIFI=n
# CONFIG_NET_DEFAULT_IF_BLUETOOTH=n
CONFIG_NET_DEFAULT_IF_IEEE802154=y


# Enable logging to help with debugging

# Enable logging
CONFIG_LOG=n
CONFIG_NET_LOG=n
CONFIG_LOG_DEFAULT_LEVEL=3

# CONFIG_NET_CONFIG_AUTO_INIT=n

# Network interface settings
# CONFIG_NET_IF_UNICAST_IPV6_ADDR_COUNT=3
# CONFIG_NET_L2_IEEE802154_RADIO_CSMA_CA=y
CONFIG_NET_L2_IEEE802154_LOG_LEVEL_DEFAULT=y
CONFIG_NET_L2_IEEE802154_LOG_LEVEL_DBG=y

# Network buffers
CONFIG_NET_PKT_RX_COUNT=16
CONFIG_NET_PKT_TX_COUNT=16
CONFIG_NET_BUF_RX_COUNT=64
CONFIG_NET_BUF_TX_COUNT=64
CONFIG_NET_CONTEXT_NET_PKT_POOL=y

# Disable IP (if not using IP over IEEE 802.15.4)
CONFIG_NET_IPV6=y
CONFIG_NET_IPV4=n

# Enable shell for debugging
CONFIG_SHELL=y
# CONFIG_SHELL_LOG_LEVEL=3

# CONFIG_MAIN_STACK_SIZE=4096
# CONFIG_NET_RX_STACK_SIZE=4096


# CONFIG_NET_PKT_RX_COUNT=10
# CONFIG_NET_BUF_DATA_SIZE=1280

# CONFIG_NET_BUF=y
CONFIG_NET_PKT_LOG_LEVEL_DBG=n


# CONFIG_NET_L2_IEEE802154_LOG_LEVEL_DBG=y
# CONFIG_NET_L2_IEEE802154_LOG_LEVEL=4
# CONFIG_IEEE802154_DRIVER_LOG_LEVEL=4
CONFIG_NET_DEBUG_L2_IEEE802154_DISPLAY_PACKET=y
CONFIG_NET_DEBUG_L2_IEEE802154_DISPLAY_PACKET_RX=y

# Activate DEBUGGING for IEEE802154 driver
CONFIG_IEEE802154_DRIVER_LOG_LEVEL_DBG=y
# CONFIG_NET_PKT_LOG_LEVEL_DBG=y
CONFIG_NET_L2_IEEE802154_LOG_LEVEL_INF=y

# Enable promiscuous mode support
CONFIG_NET_PROMISCUOUS_MODE=n

CONFIG_NET_CONTEXT_LOG_LEVEL_DBG=y
CONFIG_NET_CORE_LOG_LEVEL_DBG=y
CONFIG_NET_CONN_LOG_LEVEL_DBG=y
CONFIG_NET_IF_LOG_LEVEL_DBG=y

CONFIG_NET_L2_IEEE802154_SHELL=y

CONFIG_MAIN_STACK_SIZE=2048

CONFIG_SYSTEM_WORKQUEUE_STACK_SIZE=2048
```

## src/main.c
```c
#include <zephyr/kernel.h>
#include <zephyr/net/socket.h>
#include <zephyr/sys/printk.h>
#include <zephyr/sys/sem.h>

#define SERVER_PORT 12345         // Server listening port
#define BUFFER_SIZE 128           // Buffer size for incoming messages
#define RESPONSE_MESSAGE "Hello from server!"

#define THREAD_STACK_SIZE 1024    // Stack size for threads
#define THREAD_PRIORITY 5         // Priority for threads

static struct k_sem sync_sem;     // Semaphore for synchronizing receive and transmit
static char recv_buffer[BUFFER_SIZE]; // Buffer to store received messages
static struct sockaddr_in6 client_addr; // Client address
static socklen_t client_addr_len;
static int server_sock;          // Server socket

// Thread stack and thread definitions
K_THREAD_STACK_DEFINE(receive_stack, THREAD_STACK_SIZE);
K_THREAD_STACK_DEFINE(transmit_stack, THREAD_STACK_SIZE);
struct k_thread receive_thread_data;
struct k_thread transmit_thread_data;

void receive_thread(void *arg1, void *arg2, void *arg3) {
    ssize_t received;

    while (1) {
        memset(recv_buffer, 0, BUFFER_SIZE);
        client_addr_len = sizeof(client_addr);

        // Wait for data from a client
        received = recvfrom(server_sock, recv_buffer, BUFFER_SIZE - 1, 0,
                            (struct sockaddr *)&client_addr, &client_addr_len);
        if (received < 0) {
            printk("Failed to receive data: %d\n", errno);
            continue;
        }

        // Null-terminate the received data for printing
        recv_buffer[received] = '\0';
        printk("Received %zd bytes from client: %s\n", received, recv_buffer);

        // Signal the transmit thread to send a response
        k_sem_give(&sync_sem);
    }
}

void transmit_thread(void *arg1, void *arg2, void *arg3) {
    ssize_t sent;

    while (1) {
        // Wait for the semaphore to be given by the receive thread
        k_sem_take(&sync_sem, K_FOREVER);

        // Respond to the client
        sent = sendto(server_sock, RESPONSE_MESSAGE, strlen(RESPONSE_MESSAGE), 0,
                      (struct sockaddr *)&client_addr, client_addr_len);
        if (sent < 0) {
            printk("Failed to send response: %d\n", errno);
        } else {
            printk("Response sent to client\n");
        }

        // Add a small delay to avoid flooding the network
        k_sleep(K_MSEC(100));
    }
}

void main(void) {
    struct sockaddr_in6 server_addr;

    printk("Starting UDP server with semaphore synchronization\n");

    // Initialize semaphore
    k_sem_init(&sync_sem, 0, 1);

    // Create a UDP socket
    server_sock = socket(AF_INET6, SOCK_DGRAM, IPPROTO_UDP);
    if (server_sock < 0) {
        printk("Failed to create socket: %d\n", errno);
        return;
    }
    printk("Socket created successfully\n");

    // Configure the server address
    memset(&server_addr, 0, sizeof(server_addr));
    server_addr.sin6_family = AF_INET6;
    server_addr.sin6_port = htons(SERVER_PORT);
    server_addr.sin6_addr = in6addr_any;

    // Bind the socket to the server address and port
    if (bind(server_sock, (struct sockaddr *)&server_addr, sizeof(server_addr)) < 0) {
        printk("Failed to bind socket: %d\n", errno);
        close(server_sock);
        return;
    }
    printk("Socket bound to port %d\n", SERVER_PORT);

    // Start the receive thread
    k_thread_create(&receive_thread_data, receive_stack, THREAD_STACK_SIZE,
                    receive_thread, NULL, NULL, NULL,
                    THREAD_PRIORITY, 0, K_NO_WAIT);

    // Start the transmit thread
    k_thread_create(&transmit_thread_data, transmit_stack, THREAD_STACK_SIZE,
                    transmit_thread, NULL, NULL, NULL,
                    THREAD_PRIORITY, 0, K_NO_WAIT);
}
```
